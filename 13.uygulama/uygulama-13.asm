	__CONFIG H'3F31'
	LIST P=16F877A
	#INCLUDE <P16F877A.INC>
	DEG1 EQU 0X20
	DEG2 EQU 0X21
	SAYI1_H EQU 0X22
	SAYI1_L EQU 0X23
	SAYI2_H EQU 0X24
	SAYI2_L EQU 0X25
	SONUC_H EQU 0X26
	SONUC_L EQU 0X27
	ORG 0X00
	GOTO ANA_METOT

ANA_METOT
	BANKSEL TRISB
	CLRF TRISB
	BANKSEL PORTB
	CLRF PORTB

	MOVLW 0X02
	MOVWF SAYI1_L
	
	MOVLW 0X0A
	MOVWF SAYI2_L

	MOVLW 0X0E
	MOVWF SAYI1_H

	MOVLW 0X04
	MOVWF SAYI2_H
	
	CLRF SONUC_H

TOPLAM_L
	MOVF SAYI1_L,W
	ADDWF SAYI2_L,W
	BTFSC STATUS,C
	INCF SONUC_H
	MOVWF SONUC_L
	
TOPLAM_H
	MOVF SAYI1_H,W
	ADDWF SAYI2_H,W
	MOVWF SONUC_H

GECIKME	
	MOVLW 0XFF
	MOVWF DEG1

TEKRAR
	MOVLW 0XFF
	MOVWF DEG2

TEKRAR2
	DECFSZ DEG2,F
	GOTO TEKRAR2
	DECFSZ DEG1,F
	GOTO TEKRAR
	RETURN

END