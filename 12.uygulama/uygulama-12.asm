	__CONFIG H'3F31'
	LIST P = 16F877A
	#INCLUDE <P16F877A.INC>
	SAYI1 EQU 0X20
	SAYI2 EQU 0X21
	TOPLAM EQU 0X22
	FARK EQU 0X23
	ESÝTLÝK EQU 0X24
	ORG 0X00
	GOTO ANA_METOT

ANA_METOT
	BANKSEL TRISB
	CLRF TRISB
	BANKSEL PORTB
	CLRF PORTB

; BÜYÜK SAYI - KÜÇÜK SAYI = CARRY BÝTÝ (1)
; KÜÇÜK SAYI - BÜYÜK SAYI = CARRY BÝTÝ (0)
; BÜYÜK SAYI - KÜÇÜK SAYI = 0 ZERO BÝTÝ (1)

	MOVLW D'200'
	MOVWF SAYI1
	
	MOVLW D'230'
	MOVWF SAYI2

	BCF STATUS,C
	
	CLRW
	MOVF SAYI1,W
	ADDWF SAYI2,W
	MOVWF TOPLAM

TOPLAM_KONTROL
	BTFSS STATUS,C
	GOTO TASMA_YOK
	GOTO TASMA_VAR

TASMA_VAR
	BSF PORTB,0
	GOTO TOPLAM_KONTROL

TASMA_YOK
	BSF PORTB,1
	GOTO TOPLAM_KONTROL
	
END