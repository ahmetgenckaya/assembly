	__CONFIG H'3F31'
	LIST P=16F877A
	#INCLUDE <P16F877A.INC>
	SAYAC_1 EQU 0X20
	SAYAC_2 EQU 0X21
	ORG 0X00
	GOTO ANA_METOT

ANA_METOT
	BANKSEL TRISB
	MOVLW 0XFF
	MOVWF TRISB
	MOVLW 0X00
	MOVWF TRISC

	BANKSEL PORTB
	BSF PORTB,0
	BSF PORTB,1
	
	CLRF PORTC

;	MOVLW 0XFF
;	MOVWF PORTC

KONTROL
	BTFSC PORTB,0
	GOTO LED_ARTIR
	BTFSC PORTB,1
	GOTO LED_AZALT
	GOTO KONTROL

LED_ARTIR
	INCF PORTC,F
	CALL GECIKME
	GOTO KONTROL

LED_AZALT
	DECF PORTC,F
	CALL GECIKME
	GOTO KONTROL
	
;KONTROL
;	INCF PORTC,F
;	DECF PORTC,F
;	CALL GECIKME
;	GOTO KONTROL

GECIKME
	MOVLW 0XFF
	MOVWF SAYAC_1

TEKRAR
	MOVLW 0XFF
	MOVWF SAYAC_2

TEKRAR_2
	DECFSZ SAYAC_2
	GOTO TEKRAR_2
	DECFSZ SAYAC_1
	GOTO TEKRAR
	RETURN

END