	__CONFIG H'3F31'
	LIST P=16F877A
	#INCLUDE <P16F877A.INC>
	DEG1 EQU 0X20
	DEG2 EQU 0X21
	ORG 0X00
	GOTO ANA_METOT

ANA_METOT
	BANKSEL TRISA
	MOVLW 0X06
	MOVWF ADCON1
	MOVLW B'00000001'
	MOVWF TRISA
	CLRF TRISB
	BANKSEL PORTA
	MOVLW B'00000001'
	MOVWF PORTA
	CLRF PORTB

	MOVLW D'10'
	MOVWF PORTB

KONTROL
	BTFSS PORTA,0
	GOTO KONTROL
	GOTO GERI_SAY

GERI_SAY
	CALL AZALTMA_KONTROL
	CALL GECIKME
	DECF PORTB,F
	CALL GECIKME
	GOTO KONTROL

AZALTMA_KONTROL
	MOVF PORTB,W
	SUBLW D'0'
	BTFSC STATUS,Z
	GOTO BASADON
	RETURN

BASADON
	MOVLW D'10'
	MOVWF PORTB
	GOTO KONTROL

GECIKME
	MOVLW 0XFF
	MOVWF DEG1

TEKRAR
	MOVLW 0XFF
	MOVWF DEG2

TEKRAR_2
	DECFSZ DEG2,F
	GOTO TEKRAR_2
	DECFSZ DEG1,F
	GOTO TEKRAR
	RETURN

END
	