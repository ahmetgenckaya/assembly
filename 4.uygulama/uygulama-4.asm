	__CONFIG H'3F31'
	LIST P=16F877A
	#INCLUDE <P16F877A.INC>
	ORG 0X00
	GOTO ANA_METOT
	
ANA_METOT
	BANKSEL TRISA
	MOVLW H'06'
	MOVWF ADCON1
	MOVLW B'11111111'
	MOVWF TRISA
	MOVLW 0X00
	MOVWF TRISB
	MOVWF TRISD
	MOVLW 0XFF
	MOVWF TRISC

	BANKSEL PORTA
	MOVLW B'00111111'
	MOVWF PORTA
	MOVLW B'00001111'
	MOVWF PORTB
	MOVWF PORTD
	BSF PORTC,1
	BSF PORTC,2

KONTROL
	BTFSC PORTA,0
	GOTO SALON_KAPI
	BTFSC PORTA,1
	GOTO O1_KAPI
	BTFSC PORTA,2
	GOTO O2_KAPI
	BTFSC PORTA,3
	GOTO MUTFAK_KAPI
	BTFSC PORTA,4
	GOTO SALON_PNC
	BTFSC PORTA,5
	GOTO O1_PNC
	BTFSC PORTC,1
	GOTO O2_PNC
	BTFSC PORTC,2
	GOTO MUTFAK_PNC
	GOTO LED_SONLANDIR
	GOTO KONTROL

SALON_KAPI
	BCF PORTB,0
	BSF PORTB,4
	GOTO KONTROL

O1_KAPI
	BCF PORTB,1
	BSF PORTB,5
	GOTO KONTROL

O2_KAPI
	BCF PORTB,2
	BSF PORTB,6
	GOTO KONTROL

MUTFAK_KAPI
	BCF PORTB,3
	BSF PORTB,7 
	GOTO KONTROL

SALON_PNC
	BCF PORTD,0
	BSF PORTD,4
	GOTO KONTROL

O1_PNC
	BCF PORTD,1
	BSF PORTD,5
	GOTO KONTROL

O2_PNC
	BCF PORTD,2
	BSF PORTD,6
	GOTO KONTROL

MUTFAK_PNC
	BCF PORTD,3
	BSF PORTD,7
	GOTO KONTROL

LED_SONLANDIR
	BCF PORTB,4
	BSF PORTB,0
	BCF PORTB,5
	BSF PORTB,1
	BCF PORTB,6
	BSF PORTB,2
	BCF PORTB,7
	BSF PORTB,3
	BCF PORTD,4
	BSF PORTD,0
	BCF PORTD,5
	BSF PORTD,1
	BCF PORTD,6
	BSF PORTD,2
	BCF PORTD,7
	BSF PORTD,3
	GOTO KONTROL
	
END