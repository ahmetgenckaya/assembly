	__CONFIG H'3F31'
	LIST P=16F877A
	#INCLUDE <P16F877A.INC>
	DEG1 EQU 0X20
	DEG2 EQU 0X21
	SAYAC EQU 0X22
	ORG 0X00
	GOTO ANA_METOT

ANA_METOT
	BANKSEL TRISA
	MOVLW 0X06
	MOVWF ADCON1
	MOVLW 0XFF
	MOVWF TRISA
	CLRF TRISB
	BANKSEL PORTA
	MOVLW 0XFF
	MOVWF PORTA
	CLRF PORTB
	
	MOVLW D'3'
	MOVWF SAYAC

;KONTROL
;	BTFSC PORTA,0
;	GOTO SOL_KONTROL
;	BTFSC PORTA,1
;	GOTO SAG_KONTROL
;	GOTO KONTROL
;
;SOL_KONTROL
;	CALL GECIKME
;	RLF PORTB,F
;	CALL GECIKME
;	GOTO KONTROL
;
;SAG_KONTROL
;	CALL GECIKME
;	RRF PORTB,F
;	CALL GECIKME
;	GOTO KONTROL

;KONTROL
;	BTFSS PORTA,0
;	GOTO CIFT
;	GOTO TEK
;
;ILERI_SAY
;	CALL ARTAN_KONTROL
;	CALL GECIKME
;	INCF PORTB,F
;	CALL GECIKME
;	GOTO KONTROL
;
;ARTAN_KONTROL
;	MOVF PORTB,W
;	SUBLW D'9'
;	BTFSC STATUS,Z
;	CLRF PORTB
;	RETURN
;
KONTROL
	BTFSC PORTA,0	
	BSF PORTB,0
	DECFSZ SAYAC,F
	GOTO KONTROL
	CLRF PORTB

GECIKME
	MOVLW 0XFF
	MOVWF DEG1
TEKRAR
	MOVLW 0XFF
	MOVWF DEG2

TEKRAR_2
	DECFSZ DEG2,F
	GOTO TEKRAR_2
	DECFSZ DEG1,F
	GOTO TEKRAR
	RETURN

END